## drivers/cc310_hw/Kconfig
```kconfig
# Kconfig - Arm CC310 entropy driver for nRF52840 and nRF9160
#
# Copyright (c) 2018 Nordic Semiconductor
#
# SPDX-License-Identifier: LicenseRef-BSD-5-Clause-Nordic
#

config CC310_HW_FORCE_ALT
	bool
	depends on SOC_COMPATIBLE_NRF
	help
	  This option can be enabled to force an alternative implementation of
	  the Arm CC310 hw driver.

if !CC310_HW_FORCE_ALT

menuconfig CC310_HW
	bool "Arm CC310 HW driver for Nordic devices"
	depends on SOC_NRF52840 || SOC_NRF9160
	select MBEDTLS
	depends on NORDIC_SECURITY_BACKEND
	depends on CC310_BACKEND
	default y if CC310_BACKEND
	help
	  This option enables the Arm CC310 HW in nRF52840 and nRF9160
	  devices. This is dependant on nrf_cc310_mbedcrypto being enabled in
	  the system, e.g. through the nrf_security module

endif # !CC310_HW_FORCE_ALT
```

## lib/identity_key/Kconfig
```kconfig
#
# Copyright (c) 2022 Nordic Semiconductor ASA
#
# SPDX-License-Identifier: LicenseRef-Nordic-5-Clause
#

config IDENTITY_KEY
	bool "Identity key stored in KMU"
	depends on HAS_HW_NRF_CC310 || HAS_HW_NRF_CC312
	depends on NRF_CC3XX_PLATFORM
	depends on NRF_SECURITY
	depends on !ARM_NONSECURE_FIRMWARE
	help
	  This option adds support for retrieving an identity key stored
	  in the KMU. The key is stored in an encrypted form and is decrypted
	  by the identity key APIs,
if IDENTITY_KEY

config IDENTITY_KEY_RANDOM
	bool "Enable writing a random identity key to KMU"
	depends on MAIN_STACK_SIZE >= 2048
	help
	  This option adds support for generating an identity key and writing
	  it in an encrypted form in the KMU. The key generation will happen
	  once in the system. This feature is not required if the identity
	  key is provid
endif # IDENTITY_KEY_RANDOM
```

## samples/openthread/coap_client/boards/nrf5340dk_nrf5340_cpuappns.conf
```kconfig
#
# Copyright (c) 2021 Nordic Semiconductor
#
# SPDX-License-Identifier: LicenseRef-Nordic-5-Clause
#

# Enable TF-M
CONFIG_BUILD_WITH_TFM=y
CONFIG_TFM_BL2=n
CONFIG_PM_PARTITION_SIZE_BL2=0x0

# Disable FPU as it's currently unsupported by TF-M
CONFIG_FPU=n
CONFIG_FP_HARDABI=n
```
